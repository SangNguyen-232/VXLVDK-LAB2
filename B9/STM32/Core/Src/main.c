/* USER CODE BEGIN Header */
/**
  ******************************************************************************
  * @file           : main.c
  * @brief          : Main program body
  ******************************************************************************
  * @attention
  *
  * Copyright (c) 2025 STMicroelectronics.
  * All rights reserved.
  *
  * This software is licensed under BSD 3-Clause license.
  * You may obtain a copy of the License at:
  *                        opensource.org/licenses/BSD-3-Clause
  *
  ******************************************************************************
  */
/* USER CODE END Header */
/* Includes ------------------------------------------------------------------*/
#include "main.h"

/* Private includes ----------------------------------------------------------*/
/* USER CODE BEGIN Includes */
#include "software_timer.h"
/* USER CODE END Includes */

/* Private typedef -----------------------------------------------------------*/
/* USER CODE BEGIN PTD */
/* USER CODE END PTD */

/* Private define ------------------------------------------------------------*/
/* USER CODE BEGIN PD */
#define LED_MATRIX_SIZE 8
/* USER CODE END PD */

/* Private macro -------------------------------------------------------------*/
/* USER CODE BEGIN PM */
/* USER CODE END PM */

/* Private variables ---------------------------------------------------------*/
TIM_HandleTypeDef htim2;

/* USER CODE BEGIN PV */
int display_mode = 2;
uint8_t digits_buffer[4] = {1, 8, 5, 9};
uint16_t matrix_col[8] = {GPIO_PIN_2, GPIO_PIN_3, GPIO_PIN_10, GPIO_PIN_11, GPIO_PIN_12, GPIO_PIN_13, GPIO_PIN_14, GPIO_PIN_15};
int row = 0;
uint8_t matrix_buffer[8] = {0xFF, 0xFF, 0x83, 0xED, 0xED, 0x83, 0xFF, 0xFF};
/* USER CODE END PV */

/* Private function prototypes -----------------------------------------------*/
void SystemClock_Config(void);
static void MX_GPIO_Init(void);
static void MX_TIM2_Init(void);
/* USER CODE BEGIN PFP */
void displayDigit(int digit);
void updateLEDMatrix(int index);
/* USER CODE END PFP */

/* Private user code ---------------------------------------------------------*/
/* USER CODE BEGIN 0 */
/* USER CODE END 0 */

/**
  * @brief  The application entry point.
  * @retval int
  */
int main(void)
{
    /* USER CODE BEGIN 1 */
    /* USER CODE END 1 */

    /* MCU Configuration--------------------------------------------------------*/
    HAL_Init();

    /* USER CODE BEGIN Init */
    /* USER CODE END Init */

    /* Configure system clock */
    SystemClock_Config();

    /* USER CODE BEGIN SysInit */
    /* USER CODE END SysInit */

    /* Initialize peripherals */
    MX_GPIO_Init();
    MX_TIM2_Init();

    /* USER CODE BEGIN 2 */
    HAL_TIM_Base_Start_IT(&htim2);

    setTimer1(100);
    setTimer2(25);
    setTimer3(1);

    HAL_GPIO_WritePin(EN0_GPIO_Port, EN0_Pin, GPIO_PIN_RESET);
    HAL_GPIO_WritePin(EN1_GPIO_Port, EN1_Pin, GPIO_PIN_SET);
    HAL_GPIO_WritePin(EN2_GPIO_Port, EN2_Pin, GPIO_PIN_SET);
    HAL_GPIO_WritePin(EN3_GPIO_Port, EN3_Pin, GPIO_PIN_SET);
    displayDigit(1);

    HAL_GPIO_WritePin(GPIOA, GPIO_PIN_2|GPIO_PIN_3|GPIO_PIN_10|GPIO_PIN_11| GPIO_PIN_12|GPIO_PIN_13|GPIO_PIN_14|GPIO_PIN_15, GPIO_PIN_SET);
    HAL_GPIO_WritePin(GPIOB, GPIO_PIN_8|GPIO_PIN_9|GPIO_PIN_10|GPIO_PIN_11| GPIO_PIN_12|GPIO_PIN_13|GPIO_PIN_14|GPIO_PIN_15, GPIO_PIN_SET);

    /* USER CODE END 2 */

    /* Infinite loop */
    /* USER CODE BEGIN WHILE */
    while (1)
    {
        /* USER CODE END WHILE */
        if (t1_flag == 1) {
            HAL_GPIO_TogglePin(Led_Do_GPIO_Port, Led_Do_Pin);
            HAL_GPIO_TogglePin(DOT_GPIO_Port, DOT_Pin);
            setTimer1(100);
        }
        if (t2_flag == 1) {
            setTimer2(25);
            switch (display_mode) {
            	case 0:
                    HAL_GPIO_TogglePin(EN2_GPIO_Port, EN2_Pin);
                    HAL_GPIO_TogglePin(EN3_GPIO_Port, EN3_Pin);
                    displayDigit(digits_buffer[3]);
                    display_mode = 1;
                    break;
                case 1:
                    HAL_GPIO_TogglePin(EN3_GPIO_Port, EN3_Pin);
                    HAL_GPIO_TogglePin(EN0_GPIO_Port, EN0_Pin);
                    displayDigit(digits_buffer[0]);
                    display_mode = 2;
                    break;
                case 2:
                    HAL_GPIO_TogglePin(EN0_GPIO_Port, EN0_Pin);
                    HAL_GPIO_TogglePin(EN1_GPIO_Port, EN1_Pin);
                    displayDigit(digits_buffer[1]);
                    display_mode = 3;
                    break;
                case 3:
                    HAL_GPIO_TogglePin(EN1_GPIO_Port, EN1_Pin);
                    HAL_GPIO_TogglePin(EN2_GPIO_Port, EN2_Pin);
                    displayDigit(digits_buffer[2]);
                    display_mode = 0;
                    break;
                default:
                    break;
            }
        }

        if (t3_flag == 1) {
            updateLEDMatrix(row);
            row = (row + 1) % LED_MATRIX_SIZE;
            setTimer3(1);
        }
        /* USER CODE BEGIN 3 */
    }
    /* USER CODE END 3 */
}

/**
  * @brief System Clock Configuration
  * @retval None
  */
void SystemClock_Config(void)
{
    RCC_OscInitTypeDef RCC_OscInitStruct = {0};
    RCC_ClkInitTypeDef RCC_ClkInitStruct = {0};

    RCC_OscInitStruct.OscillatorType = RCC_OSCILLATORTYPE_HSI;
    RCC_OscInitStruct.HSIState = RCC_HSI_ON;
    RCC_OscInitStruct.HSICalibrationValue = RCC_HSICALIBRATION_DEFAULT;
    RCC_OscInitStruct.PLL.PLLState = RCC_PLL_NONE;
    if (HAL_RCC_OscConfig(&RCC_OscInitStruct) != HAL_OK) {
        Error_Handler();
    }

    RCC_ClkInitStruct.ClockType = RCC_CLOCKTYPE_HCLK|RCC_CLOCKTYPE_SYSCLK|
                                  RCC_CLOCKTYPE_PCLK1|RCC_CLOCKTYPE_PCLK2;
    RCC_ClkInitStruct.SYSCLKSource = RCC_SYSCLKSOURCE_HSI;
    RCC_ClkInitStruct.AHBCLKDivider = RCC_SYSCLK_DIV1;
    RCC_ClkInitStruct.APB1CLKDivider = RCC_HCLK_DIV1;
    RCC_ClkInitStruct.APB2CLKDivider = RCC_HCLK_DIV1;

    if (HAL_RCC_ClockConfig(&RCC_ClkInitStruct, FLASH_LATENCY_0) != HAL_OK) {
        Error_Handler();
    }
}

/**
  * @brief TIM2 Initialization Function
  * @param None
  * @retval None
  */
static void MX_TIM2_Init(void)
{
    TIM_ClockConfigTypeDef sClockSourceConfig = {0};
    TIM_MasterConfigTypeDef sMasterConfig = {0};

    htim2.Instance = TIM2;
    htim2.Init.Prescaler = 7999;
    htim2.Init.CounterMode = TIM_COUNTERMODE_UP;
    htim2.Init.Period = 9;
    htim2.Init.ClockDivision = TIM_CLOCKDIVISION_DIV1;
    htim2.Init.AutoReloadPreload = TIM_AUTORELOAD_PRELOAD_DISABLE;
    if (HAL_TIM_Base_Init(&htim2) != HAL_OK) {
        Error_Handler();
    }

    sClockSourceConfig.ClockSource = TIM_CLOCKSOURCE_INTERNAL;
    if (HAL_TIM_ConfigClockSource(&htim2, &sClockSourceConfig) != HAL_OK) {
        Error_Handler();
    }

    sMasterConfig.MasterOutputTrigger = TIM_TRGO_RESET;
    sMasterConfig.MasterSlaveMode = TIM_MASTERSLAVEMODE_DISABLE;
    if (HAL_TIMEx_MasterConfigSynchronization(&htim2, &sMasterConfig) != HAL_OK) {
        Error_Handler();
    }
}

/**
  * @brief GPIO Initialization Function
  * @param None
  * @retval None
  */
static void MX_GPIO_Init(void)
{
    GPIO_InitTypeDef GPIO_InitStruct = {0};

    __HAL_RCC_GPIOA_CLK_ENABLE();
    __HAL_RCC_GPIOB_CLK_ENABLE();

    HAL_GPIO_WritePin(GPIOA, ENM0_Pin|ENM1_Pin|DOT_Pin|Led_Do_Pin|
                           EN0_Pin|EN1_Pin|EN2_Pin|EN3_Pin|
                           ENM2_Pin|ENM3_Pin|ENM4_Pin|ENM5_Pin|
                           ENM6_Pin|ENM7_Pin, GPIO_PIN_RESET);

    HAL_GPIO_WritePin(GPIOB, SEG0_Pin|SEG1_Pin|SEG2_Pin|ROW2_Pin|
                           ROW3_Pin|ROW4_Pin|ROW5_Pin|ROW6_Pin|
                           ROW7_Pin|SEG3_Pin|SEG4_Pin|SEG5_Pin|
                           SEG6_Pin|ROW0_Pin|ROW1_Pin, GPIO_PIN_RESET);

    GPIO_InitStruct.Pin = ENM0_Pin|ENM1_Pin|DOT_Pin|Led_Do_Pin|
                          EN0_Pin|EN1_Pin|EN2_Pin|EN3_Pin|
                          ENM2_Pin|ENM3_Pin|ENM4_Pin|ENM5_Pin|
                          ENM6_Pin|ENM7_Pin;
    GPIO_InitStruct.Mode = GPIO_MODE_OUTPUT_PP;
    GPIO_InitStruct.Pull = GPIO_NOPULL;
    GPIO_InitStruct.Speed = GPIO_SPEED_FREQ_LOW;
    HAL_GPIO_Init(GPIOA, &GPIO_InitStruct);

    GPIO_InitStruct.Pin = SEG0_Pin|SEG1_Pin|SEG2_Pin|ROW2_Pin|
                          ROW3_Pin|ROW4_Pin|ROW5_Pin|ROW6_Pin|
                          ROW7_Pin|SEG3_Pin|SEG4_Pin|SEG5_Pin|
                          SEG6_Pin|ROW0_Pin|ROW1_Pin;
    GPIO_InitStruct.Mode = GPIO_MODE_OUTPUT_PP;
    GPIO_InitStruct.Pull = GPIO_NOPULL;
    GPIO_InitStruct.Speed = GPIO_SPEED_FREQ_LOW;
    HAL_GPIO_Init(GPIOB, &GPIO_InitStruct);
}

/* USER CODE BEGIN 4 */
void displayDigit(int digit)
{
    if (digit < 0 || digit > 9) return;
    const uint8_t segment_patterns[10] = {0xC0, 0xF9, 0xA4, 0xB0, 0x99, 0x92, 0x82, 0xF8, 0x80, 0x90};
    for (int i = 0; i < 7; i++) {
        HAL_GPIO_WritePin(GPIOB, GPIO_PIN_0 << i, (segment_patterns[digit] >> i) & 1);
    }
}

void updateLEDMatrix(int index)
{
    HAL_GPIO_WritePin(GPIOA, ENM0_Pin|ENM1_Pin|ENM2_Pin|ENM3_Pin|ENM4_Pin|ENM5_Pin|ENM6_Pin|ENM7_Pin, GPIO_PIN_SET);

    switch (index) {
        case 0:
        	HAL_GPIO_WritePin(GPIOA, ENM0_Pin, GPIO_PIN_RESET);
        	break;
        case 1:
        	HAL_GPIO_WritePin(GPIOA, ENM1_Pin, GPIO_PIN_RESET);
        	break;
        case 2:
        	HAL_GPIO_WritePin(GPIOA, ENM2_Pin, GPIO_PIN_RESET);
        	break;
        case 3:
        	HAL_GPIO_WritePin(GPIOA, ENM3_Pin, GPIO_PIN_RESET);
        	break;
        case 4:
        	HAL_GPIO_WritePin(GPIOA, ENM4_Pin, GPIO_PIN_RESET);
        	break;
        case 5:
        	HAL_GPIO_WritePin(GPIOA, ENM5_Pin, GPIO_PIN_RESET);
        	break;
        case 6:
        	HAL_GPIO_WritePin(GPIOA, ENM6_Pin, GPIO_PIN_RESET);
        	break;
        case 7:
        	HAL_GPIO_WritePin(GPIOA, ENM7_Pin, GPIO_PIN_RESET);
        	break;
        default:
        	break;
    }

    for (int i = 0; i < LED_MATRIX_SIZE; i++) {
        HAL_GPIO_WritePin(GPIOB, GPIO_PIN_8 << i, (matrix_buffer[index] >> i) & 1);
    }
}

void HAL_TIM_PeriodElapsedCallback(TIM_HandleTypeDef *htim)
{
    updateTimers();
}
/* USER CODE END 4 */

/**
  * @brief  Error Handler
  * @retval None
  */
void Error_Handler(void)
{
    __disable_irq();
    while (1) {}
}

#ifdef  USE_FULL_ASSERT
/**
  * @brief  Reports assert errors
  * @param  file: source file name
  * @param  line: error line number
  * @retval None
  */
void assert_failed(uint8_t *file, uint32_t line)
{
    /* USER CODE BEGIN 6 */
    /* USER CODE END 6 */
}
#endif /* USE_FULL_ASSERT */
/************************ (C) COPYRIGHT STMicroelectronics *****END OF FILE****/
